AUTOSAR XML (schema 4.0)
standard types defined: float32, float64, sint16, sint32, sint8, uint16, uint32, uint8, void, boolean
package /MappingSets
  data type mapping set MappingSet
package /Compositions
  composition sw component type Encrypt_CSComposition
