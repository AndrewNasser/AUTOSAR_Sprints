AUTOSAR XML (schema 4.0)
package /ComStack_Task
  module config CanTp
